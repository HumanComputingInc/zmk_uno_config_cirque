## config/west.yml
```yaml
manifest:
  remotes:
    - name: badjeff
      url-base: https://github.com/badjeff
    - name: zmkfirmware
      url-base: https://github.com/zmkfirmware
    - name: petejohanson
      url-base: https://github.com/petejohanson
    # Additional modules containing boards/shields/custom code can be listed here as well
    # See https://docs.zephyrproject.org/3.2.0/develop/west/manifest.html#projects
  projects:
    - name: zmk
      remote: petejohanson
      revision: feat/pointers-move-scroll
      import: app/west.yml
    # Replace the one above with the commented one below when that branch gets merged
    # into ZMK main, or if you're not using pointing devices for your build.
    # Alternatively, you can use your own zmk fork/branch if you are maintaining one.
    # - name: zmk
    #   remote: zmkfirmware
    #   revision: main
    #   import: app/west.yml
    # - name: cirque-input-module
    #   remote: badjeff
    #   revision: main
    - name: cirque-input-module
      remote: petejohanson
      revision: main
  self:
    path: config
```
